## sdkconfig.defaults
```kconfig
CONFIG_BOOTLOADER_COMPILER_OPTIMIZATION_PERF=y
CONFIG_BOOTLOADER_LOG_LEVEL_NONE=y
CONFIG_BOOTLOADER_APP_ROLLBACK_ENABLE=y
CONFIG_BOOTLOADER_SKIP_VALIDATE_ALWAYS=y
CONFIG_COMPILER_OPTIMIZATION_PERF=y
CONFIG_COMPILER_STACK_CHECK_MODE_NORM=y
CONFIG_COMPILER_WARN_WRITE_STRINGS=y
CONFIG_ESP_MAIN_TASK_STACK_SIZE=4096
CONFIG_ESP_TASK_WDT_PANIC=y
CONFIG_ESP_TASK_WDT_TIMEOUT_S=2
# CONFIG_ESP_TASK_WDT_CHECK_IDLE_TASK_CPU0 is not set
CONFIG_ESP_COREDUMP_ENABLE_TO_FLASH=y
CONFIG_ESP_COREDUMP_FLASH_NO_OVERWRITE=y
CONFIG_ESP_COREDUMP_STACK_SIZE=1280
CONFIG_FATFS_CODEPAGE_850=y
CONFIG_FREERTOS_GENERATE_RUN_TIME_STATS=y
CONFIG_LOG_MAXIMUM_LEVEL_DEBUG=y
CONFIG_LWIP_SNTP_MAX_SERVERS=16
CONFIG_LWIP_DHCP_GET_NTP_SRV=y
CONFIG_LWIP_DHCP_MAX_NTP_SERVERS=16
CONFIG_LWIP_SNTP_UPDATE_DELAY=60000
CONFIG_LWIP_SNTP_MAXIMUM_STARTUP_DELAY=1000
# CONFIG_MBEDTLS_HARDWARE_AES is not set
# CONFIG_MBEDTLS_HARDWARE_MPI is not set
# CONFIG_MBEDTLS_HARDWARE_SHA is not set
CONFIG_MBEDTLS_KEY_EXCHANGE_ECJPAKE=y
CONFIG_MBEDTLS_SSL_PROTO_DTLS=y
CONFIG_MBEDTLS_ECJPAKE_C=y
```

## sdkconfig.defaults.esp32s3
```kconfig
# CONFIG_ESPTOOLPY_FLASH_MODE_AUTO_DETECT is not set
CONFIG_ESPTOOLPY_FLASHMODE_QIO=y
CONFIG_ESPTOOLPY_FLASHSIZE_16MB=y
CONFIG_ESPTOOLPY_HEADER_FLASHSIZE_UPDATE=y
CONFIG_PARTITION_TABLE_CUSTOM=y
CONFIG_PARTITION_TABLE_CUSTOM_FILENAME="partitions.lolin-s3.csv"
CONFIG_SPIRAM=y
CONFIG_SPIRAM_MODE_OCT=y
```

## src/Kconfig
```kconfig
menu "Tempus Redux"

config CLOCKSON_WIFI_SSID
	string "WiFi Network"

config CLOCKSON_WIFI_PASSWORD
	string "WiFi Password"

config CLOCKSON_DHCP_HOSTNAME
	string "DHCP Hostname"

config CLOCKSON_SYSLOG_IP_ADDRESS
	string "Syslog IP Address"

config CLOCKSON_OUTPUT_ACTIVE_LOW
	bool "Output is active low"
	default y
	help
		Configure whether time signalling carrier is active low or high.

config CLOCKSON_UI_LED_BRIGHTNESS
	int "RGB LED brightness"
	range 0 255
	default 8
	help
		Configure LED brightness.

choice CLOCKSON_TEST_TIME
	prompt "Test time signals"
	default CLOCKSON_TEST_TIME_NONE
	help
		Configure a fixed time offset on boot. This has limited effectiveness
		because the time signal only has 2 digit years so it's open to
		interpretation by the receiver.

	config CLOCKSON_TEST_TIME_NONE
		bool "Disabled"

	config CLOCKSON_TEST_TIME_2000_BUG
		bool "1999-12-31 23:53:50"
		help
			Relive the year 2000 bug, starting 5 minutes before midnight.

	config CLOCKSON_TEST_TIME_2000_START
		bool "2000-01-01 00:00:00"
		help
			The year 2000.

	config CLOCKSON_TEST_TIME_2038_BUG
		bool "2038-01-19 03:07:50"
		help
			5 minutes before the year 2038 problem at 2038-01-19 03:14:07 UTC.

	config CLOCKSON_TEST_TIME_TMBG_2082
		bool "2082-07-18 12:00:00"
		help
			What was the look he gave intended to convey?
			Was there something else he was trying to say?
			It will all be revealed to you
			In 2082

	config CLOCKSON_TEST_TIME_2099_END
		bool "2099-12-31 23:53:50"
		help
			5 minutes before the year 2100.

	config CLOCKSON_TEST_TIME_2106_BUG
		bool "2106-02-07 06:21:50"
		help
			5 minutes before the year 2106 problem at 2106-02-07 06:28:15 UTC.

	config CLOCKSON_TEST_TIME_BUSTED_3000
		bool "3000-01-01 00:00:00"
		help
			Not much has changed but they live underwater.

	config CLOCKSON_TEST_TIME_CUSTOM
		bool "Custom"
endchoice

if !CLOCKSON_TEST_TIME_CUSTOM
	config CLOCKSON_TEST_TIME_S
		int
		default 946684430 if CLOCKSON_TEST_TIME_2000_BUG
		default 946684800 if CLOCKSON_TEST_TIME_2000_START
		default 2147483270 if CLOCKSON_TEST_TIME_2038_BUG
		default 3551598000 if CLOCKSON_TEST_TIME_TMBG_2082
		default 4102444430 if CLOCKSON_TEST_TIME_2099_END
		default 4294966910 if CLOCKSON_TEST_TIME_2106_BUG
		default 32503680000 if CLOCKSON_TEST_TIME_BUSTED_3000
endif

if CLOCKSON_TEST_TIME_CUSTOM
	config CLOCKSON_TEST_TIME_S
		int "Custom test time value"
		range 0 18446744073709551615
		default 0
		help
			Fixed time in seconds from the 1970 Unix epoch to use on boot. It
			isn't possible to use values that are less than the time taken to
			boot and sync time because that would make the uptime offset
			negative which isn't supported.

			It takes 60 seconds to transmit the time and multiple complete whole
			minutes may need to be received to take effect.
endif

endmenu
```
